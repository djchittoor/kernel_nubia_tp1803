qcom,alium_3450mah_nubia_old {
	qcom,profile-revision = <24>;
	/* #3925438_ZTE_NX606_3450mAh_averaged_MasterSlave_Mar15th2019*/
	qcom,max-voltage-uv = <4400000>;
	qcom,fg-cc-cv-threshold-mv = <4390>;
	qcom,nom-batt-capacity-mah = <3450>;
	qcom,fastchg-current-ma = <2000>;
	qcom,jeita-fcc-ranges = <0  100  850000
							101 440  2000000
							441 600  1000000>;
	qcom,jeita-fv-ranges = <0   100  4400000
							101 440  4400000
							441 600  4100000>;
	qcom,step-chg-ranges = <3600000  4200000  2000000
							4201000  4400000  2000000>;
	qcom,batt-id-kohm = <15>;
	qcom,battery-beta = <4250>;
	qcom,therm-room-temp = <100000>;
	qcom,battery-type = "alium_3450mah_nubia_old";
	qcom,therm-coefficients = <0x2318 0xd0c 0xdaf7 0xc556 0x848d>;
	qcom,therm-center-offset = <0x70>;
	qcom,therm-pull-up = <100>;
	qcom,rslow-normal-coeffs = <0x87 0xfc 0x42 0x13>;
	qcom,rslow-low-coeffs = <0x94 0x14 0xe3 0xfc>;
	qcom,checksum = <0x9468>;
	qcom,gui-version = "PM855GUI - 1.0.0.13";
	qcom,fg-profile-data = [
		 09 00 B2 EA
		 43 DC 1D E3
		 E2 DC 00 00
		 68 BC 07 8B
		 FC 87 3C 95
		 58 9D A4 80
		 28 00 87 FC
		 42 13 6D 05
		 D1 FA CE 07
		 32 00 9D EB
		 67 ED 9C D5
		 64 0A F2 D2
		 1F BD F8 0A
		 FF FA E2 CB
		 60 00 44 00
		 48 00 49 00
		 3D 00 22 00
		 2D 00 32 00
		 3C 00 40 00
		 40 00 60 00
		 36 00 3A 00
		 38 00 3A 00
		 35 00 65 00
		 57 64 46 00
		 44 00 47 08
		 60 00 51 00
		 4F 00 5C 08
		 54 08 47 00
		 9A 20 6A 40
		 55 50 4C 10
		 4B 00 D8 00
		 20 20 08 0D
		 F7 02 CB 05
		 E3 1C 30 0A
		 7C 0D C7 22
		 9B 18 40 43
		 F7 54 E9 03
		 78 11 3E 20
		 D2 FC 0B 0B
		 CC 05 E3 1C
		 E0 F9 F8 05
		 4C 0A D9 17
		 93 23 D4 44
		 DB 53 7F 12
		 01 1F 5D EC
		 1C D2 99 D6
		 D6 1C 6B C3
		 8F 04 11 BA
		 20 17 D0 8B
		 C9 84 B3 9B
		 76 A0 09 80
		 7C FA BB 05
		 46 FA E1 05
		 00 F8 67 E4
		 CC EB F6 C7
		 7E EA F1 C4
		 78 10 16 F0
		 2D BD 47 02
		 DB 05 75 00
		 CE 07 32 00
		 F7 02 C7 03
		 D2 04 05 02
		 25 02 42 05
		 AE 03 03 02
		 F3 03 48 00
		 3C 00 4A 00
		 4E 64 51 00
		 50 00 52 08
		 53 F8 50 00
		 54 00 5F 08
		 38 08 40 00
		 56 28 57 48
		 5D 58 6A 0E
		 4B 00 52 00
		 66 08 76 00
		 78 00 3E 00
		 43 08 4F 08
		 4C 00 5A 20
		 6A 48 45 58
		 51 0E 5D 00
		 61 00 4E 08
		 D8 00 CF 20
		 CA 04 CD 0A
		 2D 0C 0C 1D
		 B6 22 97 44
		 64 53 90 18
		 02 02 CB 05
		 5A 03 7A 10
		 3F 0A B0 20
		 84 04 40 03
		 95 05 E6 1C
		 A8 02 9E 04
		 91 03 8C 18
		 E6 03 DC 05
		 41 03 76 00
		 20 20 08 05
		 F7 02 CB 05
		 E3 1C 30 02
		 7C 05 C7 02
		 9B 18 40 03
		 F7 04 E9 03
		 78 00 8C 01
		 C0 00 FA 00
		 63 0D 00 00
	];
};
