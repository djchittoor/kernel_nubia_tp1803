// SPDX-License-Identifier: BSD-3-Clause
/*
 * Copyright (c) 2021, Daniel Jacob Chittoor <djchittoor47@gmail.com>
 */

&pcie0 {
	pinctrl-0 = <>;
	/delete-property/ perst-gpio;
	/delete-property/ wake-gpio;	
};
