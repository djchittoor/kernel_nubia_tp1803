// SPDX-License-Identifier: BSD-3-Clause
/*
 * Copyright (c) 2021, Daniel Jacob Chittoor <djchittoor47@gmail.com>
 */

&dai_mi2s3 {
	qcom,msm-mi2s-rx-lines = <3>;
	qcom,msm-mi2s-tx-lines = <4>;
	pinctrl-names = "default", "sleep";
	pinctrl-0 = <&quat_mi2s_active &quat_mi2s_sd0_active &quat_mi2s_sd1_active>;
	pinctrl-1 = <&quat_mi2s_sleep &quat_mi2s_sd0_sleep &quat_mi2s_sd1_sleep>;
};
